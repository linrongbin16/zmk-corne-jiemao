## config/Kconfig.corneish_zen
```kconfig
config BOARD_CORNEISH_ZEN_V1_LEFT
    depends on SOC_NRF52840_QIAA
    select BOARD_CORNEISH_ZEN_LEFT

config BOARD_CORNEISH_ZEN_V1_RIGHT
    depends on SOC_NRF52840_QIAA
    select BOARD_CORNEISH_ZEN_RIGHT

config BOARD_CORNEISH_ZEN_V2_LEFT
    depends on SOC_NRF52840_QIAA
    select BOARD_CORNEISH_ZEN_LEFT

config BOARD_CORNEISH_ZEN_V2_RIGHT
    depends on SOC_NRF52840_QIAA
    select BOARD_CORNEISH_ZEN_RIGHT
```

## config/Kconfig.defconfig
```kconfig
if BOARD_CORNEISH_ZEN_LEFT

config ZMK_KEYBOARD_NAME
    default "Corne-ish Zen"

config ZMK_SPLIT_ROLE_CENTRAL
    default y

endif # BOARD_CORNEISH_ZEN_LEFT

if BOARD_CORNEISH_ZEN_LEFT || BOARD_CORNEISH_ZEN_RIGHT

config ZMK_SPLIT
    default y

endif # BOARD_CORNEISH_ZEN_LEFT || BOARD_CORNEISH_ZEN_RIGHT
```

## config/corneish_zen_v2_left_defconfig
```kconfig
CONFIG_SOC_SERIES_NRF52X=y
CONFIG_SOC_NRF52840_QIAA=y
CONFIG_BOARD_CORNEISH_ZEN_V2_LEFT=y
CONFIG_BOARD_ENABLE_DCDC=y
CONFIG_BOARD_ENABLE_DCDC_HV=y

# Enable MPU
CONFIG_ARM_MPU=y

# enable pinctrl
CONFIG_PINCTRL=y

# enable GPIO
CONFIG_GPIO=y

# Enable SPI
CONFIG_SPI_NRFX=y

# Enable writing to flash
CONFIG_USE_DT_CODE_PARTITION=y
CONFIG_BUILD_OUTPUT_UF2=y
CONFIG_MPU_ALLOW_FLASH_WRITE=y
CONFIG_NVS=y
CONFIG_SETTINGS_NVS=y
CONFIG_FLASH=y
CONFIG_FLASH_PAGE_LAYOUT=y
CONFIG_FLASH_MAP=y

# Enable 32kHz crystal
CONFIG_CLOCK_CONTROL_NRF_K32SRC_XTAL=y
CONFIG_CLOCK_CONTROL_NRF_K32SRC_30PPM=y

# USB/蓝牙连接
CONFIG_ZMK_USB=y
CONFIG_ZMK_BLE=y

# 用于解决 Windows 中与电池报告相关的错误
CONFIG_BT_GATT_ENFORCE_SUBSCRIPTION=n
# 报告电池电量
CONFIG_BT_BAS=y
CONFIG_ZMK_BATTERY_REPORTING=y
# 分体电池电量报告
CONFIG_ZMK_SPLIT_BLE_CENTRAL_BATTERY_LEVEL_FETCHING=y
CONFIG_ZMK_SPLIT_BLE_CENTRAL_BATTERY_LEVEL_PROXY=y

#usb-name
CONFIG_USB_DEVICE_MANUFACTURER="corne_epd"

CONFIG_BT_CTLR_TX_PWR_PLUS_8=y
CONFIG_ZMK_BLE_EXPERIMENTAL_CONN=y

# 睡眠
CONFIG_ZMK_SLEEP=y
CONFIG_ZMK_IDLE_SLEEP_TIMEOUT=3600000

# 屏幕
CONFIG_ZMK_DISPLAY=n
#CONFIG_ZMK_WIDGET_LAYER_STATUS=n
```

## config/corneish_zen_v2_right_defconfig
```kconfig
# CONFIG_SOC_SERIES_NRF52X=y
# CONFIG_SOC_NRF52840_QIAA=y
# CONFIG_BOARD_CORNEISH_ZEN_V2_RIGHT=y
# CONFIG_BOARD_ENABLE_DCDC=y
# CONFIG_BOARD_ENABLE_DCDC_HV=y
#
# # 禁止睡眠
# # CONFIG_ZMK_SLEEP=y
#
# # Enable MPU
# CONFIG_ARM_MPU=y
#
# # enable pinctrl
# CONFIG_PINCTRL=y
#
# # enable GPIO
# CONFIG_GPIO=y
#
# # Enable SPI
# CONFIG_SPI_NRFX=y
#
# # Enable writing to flash
# CONFIG_USE_DT_CODE_PARTITION=y
# CONFIG_BUILD_OUTPUT_UF2=y
# CONFIG_MPU_ALLOW_FLASH_WRITE=y
# CONFIG_NVS=y
# CONFIG_SETTINGS_NVS=y
# CONFIG_FLASH=y
# CONFIG_FLASH_PAGE_LAYOUT=y
# CONFIG_FLASH_MAP=y
#
# # Enable 32kHz crystal
# CONFIG_CLOCK_CONTROL_NRF_K32SRC_XTAL=y
# CONFIG_CLOCK_CONTROL_NRF_K32SRC_30PPM=y

# 屏幕显示
CONFIG_ZMK_DISPLAY=y
CONFIG_ZMK_DISPLAY_STATUS_SCREEN_CUSTOM=y
CONFIG_ZMK_DISPLAY_WORK_QUEUE_DEDICATED=y

# 蓝牙连接
CONFIG_BT_CTLR_TX_PWR_PLUS_8=y
CONFIG_ZMK_BLE_EXPERIMENTAL_CONN=y
```
